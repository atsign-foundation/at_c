## examples/repl_esp32/main/Kconfig.projbuild
```kconfig
menu "repl_esp32 WiFi Configuration"
    config ESP_WIFI_SSID
        string "WiFi SSID"
        default "ssid"
        help
            SSID (network name) to connect to.

    config ESP_WIFI_PASSWORD
        string "WiFi Password"
        default "pswd"
        help
            WiFi password (WPA or WPA2) to use.
endmenu
```
